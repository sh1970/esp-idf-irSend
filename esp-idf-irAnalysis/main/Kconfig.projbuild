## esp-idf-irAnalysis/main/Kconfig.projbuild
```kconfig
menu "Application Configuration"

    config EXAMPLE_RMT_RX_GPIO
        int "RMT RX GPIO"
        default 19
        help
            Set the GPIO number used for receiving the RMT signal.

endmenu
```
